## Kconfig
```kconfig
mainmenu "LuxeOS Configuration"

choice ARCH
	bool "Target Architecture"
	config X86_64
		bool "x86_64"
	---help---
	Build target architecture.
endchoice

menu "CPU"
	config CPU_MAX
		int "Maximum supported CPUs"
		default 64
		---help---
		Maximum number of supported CPUs.
endmenu

choice BUILD_TYPE
	bool "Build Type"
	config DEBUG
		bool "Debug"
		---help---
		Stripped debug information, serial logging and verbose mode are disabled by default.
	config RELEASE
		bool "Release"
		---help---
		Debug information is kept in the kernel binary, serial logging and verbose mode are enabled.
endchoice
```
